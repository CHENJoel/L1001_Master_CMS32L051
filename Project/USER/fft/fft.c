#include "fft.h"
#include "Function_Init.H"
/**************************************************************************************************************************************************************************************************************************/
/**************************************************************************************************************************************************************************************************************************/
/**************************************************************************************************************************************************************************************************************************/
/**************************************************************************************************************************************************************************************************************************/
/**************************************************************************************************************************************************************************************************************************/
/**************************************************************************************************************************************************************************************************************************/
/**************************************************************************************************************************************************************************************************************************/
/**************************************************************************************************************************************************************************************************************************/
/**************************************************************************************************************************************************************************************************************************/
/**************************************************************************************************************************************************************************************************************************/
/**************************************************************************************************************************************************************************************************************************/
/**************************************************************************************************************************************************************************************************************************/
/**************************************************************************************************************************************************************************************************************************/
/**************************************************************************************************************************************************************************************************************************/
/**************************************************************************************************************************************************************************************************************************/
/**************************************************************************************************************************************************************************************************************************/
/**************************************************************************************************************************************************************************************************************************/
/**************************************************************************************************************************************************************************************************************************/
/**************************************************************************************************************************************************************************************************************************/
/**************************************************************************************************************************************************************************************************************************/
/**************************************************************************************************************************************************************************************************************************/
/**************************************************************************************************************************************************************************************************************************/
/**************************************************************************************************************************************************************************************************************************/
/**************************************************************************************************************************************************************************************************************************/
/**************************************************************************************************************************************************************************************************************************/
/**************************************************************************************************************************************************************************************************************************/
/**************************************************************************************************************************************************************************************************************************/
/**************************************************************************************************************************************************************************************************************************/
/**************************************************************************************************************************************************************************************************************************/
/**************************************************************************************************************************************************************************************************************************/
/**************************************************************************************************************************************************************************************************************************/
/**************************************************************************************************************************************************************************************************************************/
/**************************************************************************************************************************************************************************************************************************/
/**************************************************************************************************************************************************************************************************************************/
/**************************************************************************************************************************************************************************************************************************/
/**************************************************************************************************************************************************************************************************************************/






// // // // // // // // // // // // // // // // // // // // // // // // // // // // // // // // // // // struct compx dd[65]; //FFT数据
// // // // // // // // // // // // // // // // // // // // // // // // // // // // // // // // // // // struct compx temp_dd;
// // // // // // // // // // // // // // // // // // // // // // // // // // // // // // // // // // // // // // uchar refreshflag[40];
// // // // // // // // // // // // // // // // // // // // // // // // // // // // // // // // // // // // // // uchar  LEDBuf[35];	  //15列；从左到右；亮的位为真（1）；



// // // // // // // // // // // // // // // // // // // // // // // // // // // // // // // // // // // const float iw[64] =
// // // // // // // // // // // // // // // // // // // // // // // // // // // // // // // // // // // {
// // // // // // // // // // // // // // // // // // // // // // // // // // // // // // // // // // //     1.000, 0, 0.9952, -0.0980, 0.9808, -0.1951, 0.9569, -0.2903, 0.9239, -0.3827, 0.8819, -0.4714, 0.8315, -0.5556,
// // // // // // // // // // // // // // // // // // // // // // // // // // // // // // // // // // //     0.7730, -0.6344, 0.7071, -0.7071, 0.6344, -0.7730, 0.5556, -0.8315, 0.4714, -0.8819, 0.3827, -0.9239, 0.2903, -0.9569,
// // // // // // // // // // // // // // // // // // // // // // // // // // // // // // // // // // //     0.1951, -0.9808, 0.0980, -0.9952, 0.0, -1.0000, -0.0980, -0.9952, -0.1951, -0.9808, -0.2903, 0.9569, -0.3827, -0.9239,
// // // // // // // // // // // // // // // // // // // // // // // // // // // // // // // // // // //     -0.4714, -0.8819, -0.5556, -0.8315, -0.6344, -0.7730, -0.7071, -0.7071, -0.7730, -0.6344, -0.8315, -0.5556, -0.8819, -0.4714,
// // // // // // // // // // // // // // // // // // // // // // // // // // // // // // // // // // //     -0.9239, -0.3827, -0.9569, -0.2903, -0.9808, -0.1951, -0.9952, -0.0980};

// // // // // // // // // // // // // // // // // // // // // // // // // // // // // // // // // // // const uint16_t test_sin[]=
// // // // // // // // // // // // // // // // // // // // // // // // // // // // // // // // // // // {
// // // // // // // // // // // // // // // // // // // // // // // // // // // // // // // // // // //     // // 456,1913, 12, 1745, 738, 695, 1774, 6, 1894, 494, 956, 1581, 70, 1980, 285, 1219, 1347, 199, 1998, 127, 1468, 1088, 
// // // // // // // // // // // // // // // // // // // // // // // // // // // // // // // // // // //     // // 384, 1945, 29, 1683, 824, 612, 1827, 0, 1851, 572, 868, 1650, 41, 1959, 350, 1132, 1428, 149, 2000, 173, 1388, 1176,
// // // // // // // // // // // // // // // // // // // // // // // // // // // // // // // // // // //     // //  317, 1971, 55, 1616, 912, 532, 1873, 2, 1801, 653, 781, 1715, 20, 1930, 419, 1044, 1506, 106,1994,226
// // // // // // // // // // // // // // // // // // // // // // // // // // // // // // // // // // //     1195,1383,1556,1707,1831,1924,1981,2000,1981,1924,1831,1707,1556,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1000,
// // // // // // // // // // // // // // // // // // // // // // // // // // // // // // // // // // // };

// // // // // // // // // // // // // // // // // // // // // // // // // // // // // // // // // // // //复数乘法
// // // // // // // // // // // // // // // // // // // // // // // // // // // // // // // // // // // void ee(struct compx b1, uint8_t b2)
// // // // // // // // // // // // // // // // // // // // // // // // // // // // // // // // // // // {
// // // // // // // // // // // // // // // // // // // // // // // // // // // // // // // // // // // 	temp_dd.real = b1.real * iw[2 * b2] - b1.imag * iw[2 * b2 + 1];
// // // // // // // // // // // // // // // // // // // // // // // // // // // // // // // // // // // 	temp_dd.imag = b1.real * iw[2 * b2 + 1] + b1.imag * iw[2 * b2];
// // // // // // // // // // // // // // // // // // // // // // // // // // // // // // // // // // // }
// // // // // // // // // // // // // // // // // // // // // // // // // // // // // // // // // // // //乘方函数
// // // // // // // // // // // // // // // // // // // // // // // // // // // // // // // // // // // uint mypow(uint8_t nbottom, uint8_t ntop)
// // // // // // // // // // // // // // // // // // // // // // // // // // // // // // // // // // // {
// // // // // // // // // // // // // // // // // // // // // // // // // // // // // // // // // // // 	uint result = 1;
// // // // // // // // // // // // // // // // // // // // // // // // // // // // // // // // // // // 	uint8_t t;
// // // // // // // // // // // // // // // // // // // // // // // // // // // // // // // // // // // 	for (t = 0; t < ntop; t++)
// // // // // // // // // // // // // // // // // // // // // // // // // // // // // // // // // // // 		result *= nbottom;
// // // // // // // // // // // // // // // // // // // // // // // // // // // // // // // // // // // 	return result;
// // // // // // // // // // // // // // // // // // // // // // // // // // // // // // // // // // // }
// // // // // // // // // // // // // // // // // // // // // // // // // // // // // // // // // // // //快速傅立叶变换
// // // // // // // // // // // // // // // // // // // // // // // // // // // // // // // // // // // void fft(struct compx *xin, uint8_t N)
// // // // // // // // // // // // // // // // // // // // // // // // // // // // // // // // // // // {
// // // // // // // // // // // // // // // // // // // // // // // // // // // // // // // // // // // 	uint8_t fftnum, i, j, k, l, m, n, disbuff, dispos, dissec;
// // // // // // // // // // // // // // // // // // // // // // // // // // // // // // // // // // // 	struct compx t;
// // // // // // // // // // // // // // // // // // // // // // // // // // // // // // // // // // // 	fftnum = N; //傅立叶变换点数
// // // // // // // // // // // // // // // // // // // // // // // // // // // // // // // // // // // 	for (m = 1; (fftnum = fftnum / 2) != 1; m++)
// // // // // // // // // // // // // // // // // // // // // // // // // // // // // // // // // // // 		;						 //求得M的值
// // // // // // // // // // // // // // // // // // // // // // // // // // // // // // // // // // // 	for (k = 0; k <= N - 1; k++) //码位倒置
// // // // // // // // // // // // // // // // // // // // // // // // // // // // // // // // // // // 	{
// // // // // // // // // // // // // // // // // // // // // // // // // // // // // // // // // // // 		n = k;
// // // // // // // // // // // // // // // // // // // // // // // // // // // // // // // // // // // 		j = 0;
// // // // // // // // // // // // // // // // // // // // // // // // // // // // // // // // // // // 		for (i = m; i > 0; i--) //倒置
// // // // // // // // // // // // // // // // // // // // // // // // // // // // // // // // // // // 		{
// // // // // // // // // // // // // // // // // // // // // // // // // // // // // // // // // // // 			j = j + ((n % 2) << (i - 1));
// // // // // // // // // // // // // // // // // // // // // // // // // // // // // // // // // // // 			n = n / 2;
// // // // // // // // // // // // // // // // // // // // // // // // // // // // // // // // // // // 		}
// // // // // // // // // // // // // // // // // // // // // // // // // // // // // // // // // // // 		if (k < j)
// // // // // // // // // // // // // // // // // // // // // // // // // // // // // // // // // // // 		{
// // // // // // // // // // // // // // // // // // // // // // // // // // // // // // // // // // // 			t = xin[1 + j];
// // // // // // // // // // // // // // // // // // // // // // // // // // // // // // // // // // // 			xin[1 + j] = xin[1 + k];
// // // // // // // // // // // // // // // // // // // // // // // // // // // // // // // // // // // 			xin[1 + k] = t;
// // // // // // // // // // // // // // // // // // // // // // // // // // // // // // // // // // // 		} //交换数据
// // // // // // // // // // // // // // // // // // // // // // // // // // // // // // // // // // // 	}
// // // // // // // // // // // // // // // // // // // // // // // // // // // // // // // // // // // 	for (l = 1; l <= m; l++) // FFT运算
// // // // // // // // // // // // // // // // // // // // // // // // // // // // // // // // // // // 	{
// // // // // // // // // // // // // // // // // // // // // // // // // // // // // // // // // // // 		disbuff = mypow(2, l); //求得碟间距离
// // // // // // // // // // // // // // // // // // // // // // // // // // // // // // // // // // // 		dispos = disbuff / 2;  //求得碟形两点之间的距离
// // // // // // // // // // // // // // // // // // // // // // // // // // // // // // // // // // // 		for (j = 1; j <= dispos; j++)
// // // // // // // // // // // // // // // // // // // // // // // // // // // // // // // // // // // 			for (i = j; i < N; i = i + disbuff) //遍历M级所有的碟形
// // // // // // // // // // // // // // // // // // // // // // // // // // // // // // // // // // // 			{
// // // // // // // // // // // // // // // // // // // // // // // // // // // // // // // // // // // 				dissec = i + dispos;								//求得第二点的位置
// // // // // // // // // // // // // // // // // // // // // // // // // // // // // // // // // // // 				ee(xin[dissec], (uint)(j - 1) * (uint)N / disbuff); //复数乘法
// // // // // // // // // // // // // // // // // // // // // // // // // // // // // // // // // // // 				t = temp_dd;
// // // // // // // // // // // // // // // // // // // // // // // // // // // // // // // // // // // 				xin[dissec].real = xin[i].real - t.real;
// // // // // // // // // // // // // // // // // // // // // // // // // // // // // // // // // // // 				xin[dissec].imag = xin[i].imag - t.imag;
// // // // // // // // // // // // // // // // // // // // // // // // // // // // // // // // // // // 				xin[i].real = xin[i].real + t.real;
// // // // // // // // // // // // // // // // // // // // // // // // // // // // // // // // // // // 				xin[i].imag = xin[i].imag + t.imag;
// // // // // // // // // // // // // // // // // // // // // // // // // // // // // // // // // // // 			}
// // // // // // // // // // // // // // // // // // // // // // // // // // // // // // // // // // // 	}
// // // // // // // // // // // // // // // // // // // // // // // // // // // // // // // // // // // }

// // // // // // // // // // // // // // // // // // // // // // // // // // // // // // // // // // // //完成显示数据的转换工作,包括顶点下落速度控制以及顶点更新定格
// // // // // // // // // // // // // // // // // // // // // // // // // // // // // // // // // // // //对fft数据进行处理,得到各个频率段的电压幅值
// // // // // // // // // // // // // // // // // // // // // // // // // // // // // // // // // // // void processfft(void)
// // // // // // // // // // // // // // // // // // // // // // // // // // // // // // // // // // // {
// // // // // // // // // // // // // // // // // // // // // // // // // // // // // // // // // // // 	uint8_t pt = 0, tmp;
// // // // // // // // // // // // // // // // // // // // // // // // // // // // // // // // // // // 	uint8_t i;
// // // // // // // // // // // // // // // // // // // // // // // // // // // // // // // // // // // 	float temp;
// // // // // // // // // // // // // // // // // // // // // // // // // // // // // // // // // // // 	uint8_t tempNum;
// // // // // // // // // // // // // // // // // // // // // // // // // // // // // // // // // // // 	// if (DMAVEC->CTRL[CTRL_DATA_ADC].DMACT == 0)
// // // // // // // // // // // // // // // // // // // // // // // // // // // // // // // // // // // 	// {
// // // // // // // // // // // // // // // // // // // // // // // // // // // // // // // // // // // 		for (pt = 0; pt < 65; pt++)
// // // // // // // // // // // // // // // // // // // // // // // // // // // // // // // // // // // 		{
// // // // // // // // // // // // // // // // // // // // // // // // // // // // // // // // // // // 			// dd[pt].real = ADC_Buffer[pt]+ ADC_Buffer[pt]<<2;
// // // // // // // // // // // // // // // // // // // // // // // // // // // // // // // // // // // 			// dd[pt].real = 10;
// // // // // // // // // // // // // // // // // // // // // // // // // // // // // // // // // // // 			// dd[pt].real = xadc.micbuf[pt]+xadc.micbuf[pt+1];
// // // // // // // // // // // // // // // // // // // // // // // // // // // // // // // // // // //             // dd[pt].real = xadc.micbuf[pt];

// // // // // // // // // // // // // // // // // // // // // // // // // // // // // // // // // // //             dd[pt].real = test_sin[i];
// // // // // // // // // // // // // // // // // // // // // // // // // // // // // // // // // // // 			dd[pt].imag = 0; //清零虚部
// // // // // // // // // // // // // // // // // // // // // // // // // // // // // // // // // // // 		}
// // // // // // // // // // // // // // // // // // // // // // // // // // // // // // // // // // // 		fft(dd, 64); //对当前数据进行傅立叶变换

// // // // // // // // // // // // // // // // // // // // // // // // // // // // // // // // // // // 		for (pt = 0; pt < 65; pt++)
// // // // // // // // // // // // // // // // // // // // // // // // // // // // // // // // // // // 		{
// // // // // // // // // // // // // // // // // // // // // // // // // // // // // // // // // // // 			// printf("%f\n",dd[pt].real);
// // // // // // // // // // // // // // // // // // // // // // // // // // // // // // // // // // // 			dd[pt].real = sqrt(dd[pt].real * dd[pt].real + dd[pt].imag * dd[pt].imag); //取均方根
// // // // // // // // // // // // // // // // // // // // // // // // // // // // // // // // // // // 		}
// // // // // // // // // // // // // // // // // // // // // // // // // // // // // // // // // // // 		// // FFT_Flash=1;	//
// // // // // // // // // // // // // // // // // // // // // // // // // // // // // // // // // // // 		// printf("A%f\r\n",dd[0].real);
// // // // // // // // // // // // // // // // // // // // // // // // // // // // // // // // // // // 		// printf("B%f\r\n",dd[1].real);
// // // // // // // // // // // // // // // // // // // // // // // // // // // // // // // // // // // 		// printf("C%f\r\n",dd[2].real);
// // // // // // // // // // // // // // // // // // // // // // // // // // // // // // // // // // // 		// printf("D%f\r\n",dd[4].real);
// // // // // // // // // // // // // // // // // // // // // // // // // // // // // // // // // // // 		// printf("E%f\r\n",dd[6].real);
// // // // // // // // // // // // // // // // // // // // // // // // // // // // // // // // // // // 		// printf("F%f\r\n",dd[8].real);
// // // // // // // // // // // // // // // // // // // // // // // // // // // // // // // // // // // 		// printf("G%f\r\n",dd[10].real);

// // // // // // // // // // // // // // // // // // // // // // // // // // // // // // // // // // //         // // PRINT(fft, "%f,%f,%f,%f,%f,%f,%f,%f,%f,%f,%f,%f,%f,%f", dd[0].real,dd[1].real,dd[2].real,dd[3].real,dd[4].real,dd[5].real,dd[6].real,dd[7].real,dd[9].real,dd[10].real,dd[11].real,dd[12].real,dd[13].real,dd[14].real,dd[15].real);
// // // // // // // // // // // // // // // // // // // // // // // // // // // // // // // // // // //         PRINT(fft, "%f,%f,%f,%f,%f,%f,%f,%f,%f,%f,%f,%f,%f,%f,%f", dd[0].real,dd[1].real,dd[2].real,dd[3].real,dd[4].real,dd[5].real,dd[6].real,dd[7].real,dd[8].real,dd[9].real,dd[10].real,dd[11].real,dd[12].real,dd[13].real,dd[14].real,dd[15].real);
// // // // // // // // // // // // // // // // // // // // // // // // // // // // // // // // // // // 		// printf("H%f\r\n",dd[12].real);
// // // // // // // // // // // // // // // // // // // // // // // // // // // // // // // // // // // 		// printf("I%f\r\n",dd[14].real);
// // // // // // // // // // // // // // // // // // // // // // // // // // // // // // // // // // // 		// printf("J%f\r\n",dd[16].real);
// // // // // // // // // // // // // // // // // // // // // // // // // // // // // // // // // // // 		// printf("K%f\r\n",dd[18].real);
// // // // // // // // // // // // // // // // // // // // // // // // // // // // // // // // // // // 		// printf("L%f\r\n",dd[20].real);
// // // // // // // // // // // // // // // // // // // // // // // // // // // // // // // // // // // 		// printf("M%f\r\n",dd[22].real);
// // // // // // // // // // // // // // // // // // // // // // // // // // // // // // // // // // // 		// printf("N%f\r\n",dd[24].real);
// // // // // // // // // // // // // // // // // // // // // // // // // // // // // // // // // // // 		// printf("O%f\r\n",dd[26].real);
// // // // // // // // // // // // // // // // // // // // // // // // // // // // // // // // // // // 		// printf("P%f\r\n",dd[28].real);
// // // // // // // // // // // // // // // // // // // // // // // // // // // // // // // // // // // 		// printf("Q%f\r\n",dd[30].real);
// // // // // // // // // // // // // // // // // // // // // // // // // // // // // // // // // // // 		// printf("B%f\n",dd[pt].real);
// // // // // // // // // // // // // // // // // // // // // // // // // // // // // // // // // // // 		// printf("\n\n\n");
// // // // // // // // // // // // // // // // // // // // // // // // // // // // // // // // // // // 		// printf("\n\n%f\n\n",dd[6].real);

// // // // // // // // // // // // // // // // // // // // // // // // // // // // // // // // // // // 	// 	DMA_Start(DMA_VECTOR_ADC, CTRL_DATA_ADC, DMA_MODE_NORMAL,
// // // // // // // // // // // // // // // // // // // // // // // // // // // // // // // // // // // 	// 			  DMA_SIZE_HALF, ADC_CNT, (uint16_t *)&ADC->ADCR, ADC_Buffer);
// // // // // // // // // // // // // // // // // // // // // // // // // // // // // // // // // // // 	// }
// // // // // // // // // // // // // // // // // // // // // // // // // // // // // // // // // // // }

/**************************************************************************************************************************************************************************************************************************/
/**************************************************************************************************************************************************************************************************************************/
/**************************************************************************************************************************************************************************************************************************/
/**************************************************************************************************************************************************************************************************************************/
/**************************************************************************************************************************************************************************************************************************/
/**************************************************************************************************************************************************************************************************************************/
/**************************************************************************************************************************************************************************************************************************/
/**************************************************************************************************************************************************************************************************************************/
/**************************************************************************************************************************************************************************************************************************/
/**************************************************************************************************************************************************************************************************************************/
/**************************************************************************************************************************************************************************************************************************/
/**************************************************************************************************************************************************************************************************************************/
/**************************************************************************************************************************************************************************************************************************/
/**************************************************************************************************************************************************************************************************************************/
/**************************************************************************************************************************************************************************************************************************/
/**************************************************************************************************************************************************************************************************************************/
/**************************************************************************************************************************************************************************************************************************/
/**************************************************************************************************************************************************************************************************************************/
/**************************************************************************************************************************************************************************************************************************/
/**************************************************************************************************************************************************************************************************************************/
/**************************************************************************************************************************************************************************************************************************/
/**************************************************************************************************************************************************************************************************************************/
/**************************************************************************************************************************************************************************************************************************/
/**************************************************************************************************************************************************************************************************************************/
/**************************************************************************************************************************************************************************************************************************/
/**************************************************************************************************************************************************************************************************************************/
/**************************************************************************************************************************************************************************************************************************/
/**************************************************************************************************************************************************************************************************************************/
/**************************************************************************************************************************************************************************************************************************/
/**************************************************************************************************************************************************************************************************************************/
/**************************************************************************************************************************************************************************************************************************/
/**************************************************************************************************************************************************************************************************************************/
/**************************************************************************************************************************************************************************************************************************/
/**************************************************************************************************************************************************************************************************************************/
/**************************************************************************************************************************************************************************************************************************/
/**************************************************************************************************************************************************************************************************************************/

Complex data_of_N_FFT[FFT_N] = {5120,0,4096,0,3072,0,4096,0,5120,0,4096,0,3072,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0,

};			//定义存储单元，原始数据与复数结果均使用之 
double SIN_TABLE_of_N_FFT[FFT_N / 4 + 1];
//创建正弦函数表 初始化FFT程序 
void Init_FFT(void)
{
	int i;
	for (i = 0; i <= FFT_N / 4; i++)
	{
		SIN_TABLE_of_N_FFT[i] = sin(2 * i * PI / FFT_N);
	}
}

double Sin_find(double x)
{
	int i = (int)(FFT_N * x);	//注意：i已经转化为0~N之间的整数了！ 
	i = i >> 1;					// i = i / 2;
	if (i > FFT_N / 4)
	{	//根据FFT相关公式，sin()参数不会超过PI， 即i不会超过N/2 
		i = FFT_N / 2 - i;//i = i - 2*(i-Npart4);
	}
	return SIN_TABLE_of_N_FFT[i];
}

double Cos_find(double x)
{
	int i = (int)(FFT_N*x);//注意：i已经转化为0~N之间的整数了！ 
	i = i >> 1;
	if (i < FFT_N / 4)
	{ //不会超过N/2 
		return SIN_TABLE_of_N_FFT[FFT_N / 4 - i];
	}
	else //i > Npart4 && i < N/2 
	{
		return -SIN_TABLE_of_N_FFT[i - FFT_N / 4];
	}
}

//变址 
void ChangeSeat(Complex *DataInput)
{
	int nextValue, nextM, i, k, j = 0;
	Complex temp;

	nextValue = FFT_N / 2;					//变址运算，即把自然顺序变成倒位序，采用雷德算法
	nextM = FFT_N - 1;
	for (i = 0; i < nextM; i++)
	{
		if (i < j)							//如果i<j,即进行变址
		{
			temp = DataInput[j];
			DataInput[j] = DataInput[i];
			DataInput[i] = temp;
		}
		k = nextValue;						//求j的下一个倒位序
		while (k <= j)						//如果k<=j,表示j的最高位为1
		{
			j = j - k;						//把最高位变成0
			k = k / 2;						//k/2，比较次高位，依次类推，逐个比较，直到某个位为0
		}
		j = j + k;							//把0改为1
	}
}

//FFT运算函数 
void FFT(void)
{
	int L = FFT_N, B, J, K, M_of_N_FFT;
	int step, KB;
	double angle;
	Complex W, Temp_XX;

	ChangeSeat(data_of_N_FFT);				//变址 
											//CREATE_SIN_TABLE();
	for (M_of_N_FFT = 1; (L = L >> 1) != 1; ++M_of_N_FFT);	//计算蝶形级数
	for (L = 1; L <= M_of_N_FFT; L++)
	{
		step = 1 << L;						//2^L
		B = step >> 1;						//B=2^(L-1)
		for (J = 0; J < B; J++)
		{
			//P = (1<<(M-L))*J;//P=2^(M-L) *J 
			angle = (double)J / B;			//这里还可以优化 
			W.real = Cos_find(angle); 		//使用C++时该函数可声明为inline W.real =  cos(angle*PI);
			W.imag = -Sin_find(angle);		//使用C++时该函数可声明为inline W.imag = -sin(angle*PI);

			for (K = J; K < FFT_N; K = K + step)
			{
				KB = K + B;
				//Temp_XX = XX_complex(data[KB],W); 用下面两行直接计算复数乘法，省去函数调用开销 
				Temp_XX.real = data_of_N_FFT[KB].real * W.real - data_of_N_FFT[KB].imag*W.imag;
				Temp_XX.imag = W.imag*data_of_N_FFT[KB].real + data_of_N_FFT[KB].imag*W.real;

				data_of_N_FFT[KB].real = data_of_N_FFT[K].real - Temp_XX.real;
				data_of_N_FFT[KB].imag = data_of_N_FFT[K].imag - Temp_XX.imag;

				data_of_N_FFT[K].real = data_of_N_FFT[K].real + Temp_XX.real;
				data_of_N_FFT[K].imag = data_of_N_FFT[K].imag + Temp_XX.imag;
			}
		}
	}
}

//IFFT运算函数 
void IFFT(void)
{
	int L = FFT_N, B, J, K, M_of_N_FFT;
	int step, KB;
	double angle;
	Complex W, Temp_XX;

	ChangeSeat(data_of_N_FFT);//变址 

	for (M_of_N_FFT = 1; (L = L >> 1) != 1; ++M_of_N_FFT);	//计算蝶形级数
	for (L = 1; L <= M_of_N_FFT; L++)
	{
		step = 1 << L;						//2^L
		B = step >> 1;						//B=2^(L-1)
		for (J = 0; J<B; J++)
		{
			angle = (double)J / B;			//这里还可以优化  
			W.real = Cos_find(angle);		//使用C++时该函数可声明为inline W.real = cos(angle*PI);
			W.imag = Sin_find(angle);		//使用C++时该函数可声明为inline W.imag = sin(angle*PI);

			for (K = J; K < FFT_N; K = K + step)
			{
				KB = K + B;
				//用下面两行直接计算复数乘法，省去函数调用开销 
				Temp_XX.real = data_of_N_FFT[KB].real * W.real - data_of_N_FFT[KB].imag*W.imag;
				Temp_XX.imag = W.imag*data_of_N_FFT[KB].real + data_of_N_FFT[KB].imag*W.real;

				data_of_N_FFT[KB].real = data_of_N_FFT[K].real - Temp_XX.real;
				data_of_N_FFT[KB].imag = data_of_N_FFT[K].imag - Temp_XX.imag;

				data_of_N_FFT[K].real = data_of_N_FFT[K].real + Temp_XX.real;
				data_of_N_FFT[K].imag = data_of_N_FFT[K].imag + Temp_XX.imag;
			}
		}
	}
}

/*****************************************************************
函数原型：void Refresh_Data(int id, double wave_data)
函数功能：更新数据
输入参数：id: 标号; wave_data: 一个点的值
输出参数：无
*****************************************************************/
void Refresh_Data(int id, double wave_data)
{
	data_of_N_FFT[id].real = wave_data;
	data_of_N_FFT[id].imag = 0;
}


void abs_fft(void)
{
	uint8_t i;
	for (i = 0; i < FFT_N; i++)
	{
		if (data_of_N_FFT[i].real < 0)
		{
			data_of_N_FFT[i].real = -data_of_N_FFT[i].real;
		}
	}
}
